#include <stdio.h>
#include <string.h>
#include <sys/param.h>
#include <stdlib.h>
#include "sdkconfig.h"
#include "freertos/FreeRTOS.h"
#include "freertos/task.h"
#include "esp_system.h"
#include "esp_spi_flash.h"
#include "driver/uart.h"
#include "driver/gpio.h"
#include "esp_log.h"
#include "modbusrtu.h"
/* Table of CRC values for high–order byte */
const uint8_t crctablehi[] = {
	0x00, 0xC1, 0x81, 0x40, 0x01, 0xC0, 0x80, 0x41, 0x01, 0xC0, 0x80, 0x41, 0x00, 0xC1, 0x81,
	0x40, 0x01, 0xC0, 0x80, 0x41, 0x00, 0xC1, 0x81, 0x40, 0x00, 0xC1, 0x81, 0x40, 0x01, 0xC0,
	0x80, 0x41, 0x01, 0xC0, 0x80, 0x41, 0x00, 0xC1, 0x81, 0x40, 0x00, 0xC1, 0x81, 0x40, 0x01,
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	0x00, 0xC1, 0x81, 0x40, 0x01, 0xC0, 0x80, 0x41, 0x01, 0xC0, 0x80, 0x41, 0x00, 0xC1, 0x81,
	0x40
};
/* Table of CRC values for low–order byte */
const uint8_t crctablelo[] = {
	0x00, 0xC0, 0xC1, 0x01, 0xC3, 0x03, 0x02, 0xC2, 0xC6, 0x06, 0x07, 0xC7, 0x05, 0xC5, 0xC4,
	0x04, 0xCC, 0x0C, 0x0D, 0xCD, 0x0F, 0xCF, 0xCE, 0x0E, 0x0A, 0xCA, 0xCB, 0x0B, 0xC9, 0x09,
	0x08, 0xC8, 0xD8, 0x18, 0x19, 0xD9, 0x1B, 0xDB, 0xDA, 0x1A, 0x1E, 0xDE, 0xDF, 0x1F, 0xDD,
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	0x44, 0x84, 0x85, 0x45, 0x87, 0x47, 0x46, 0x86, 0x82, 0x42, 0x43, 0x83, 0x41, 0x81, 0x80,
	0x40
};
uint8_t local_addr=1;
uint16_t usMBCRC16(uint8_t *ptr, uint32_t len)
{
    uint8_t crchi = 0xff;
	uint8_t crclo = 0xff; 
	uint16_t index;
	uint8_t ch;
	int i=0;
	while (len--) 
	{
		ch = *ptr++;
		index = crclo ^ ch; 
		crclo = crchi ^ crctablehi[index];
		crchi = crctablelo[index];
		//printf("%d:%02x\t%04x\n",i,ch,crchi << 8 | crclo);
		i++;
	}
	return (crchi << 8 | crclo);

}
/*
发送 错误反馈
*/
void mb_sentACK(uint8_t cm, uint8_t err,_serialbuf_st *tx)
{
    uint16_t temp;
    tx->buf[0] = local_addr;
    tx->buf[1] = cm + 0x80;
    tx->buf[2] = err;
    temp = usMBCRC16(tx->buf, 3);
    tx->buf[3] = temp; //低
    tx->buf[4] = temp >> 8;
    tx->len=5;
}
/*
回应 读保持寄存器，命令0X03
*/
void mb_sentfor_readHoldingReg(const _mbdata_st mbd,_serialbuf_st *tx)
{
    uint16_t temp;
    uint8_t len = mbd.len * 2 + 5;
    tx->buf[0] = local_addr;
    tx->buf[1] = 0x03;
    tx->buf[2] = mbd.len * 2;
    /*用户数据*/
    for (temp = 0; temp < (len - 5) / 2; temp++)
    {
        tx->buf[3 + temp * 2] = mbd.buf[mbd.start + temp] >> 8;
        tx->buf[4 + temp * 2] = mbd.buf[mbd.start + temp];
    }
    temp = usMBCRC16(tx->buf, len - 2);
    tx->buf[len - 2] = temp; //低
    tx->buf[len - 1] = temp >> 8;
    tx->len=len;
    //ESP_LOGI("serial  ", "tx->len %d", tx->len);
    esp_log_buffer_hex("tx  ", tx->buf, tx->len);
}
/*
回应 写保持寄存器，命令0X10
*/
void mb_sentfor_writeHoldingReg(_serialbuf_st rx,_mbdata_st *pmb,_serialbuf_st *tx)
{
    uint16_t temp;
    uint8_t i;
    temp = usMBCRC16(rx.buf, 6);
    
    memcpy(tx->buf,rx.buf,6);
    tx->buf[6] = temp;
    tx->buf[7] = temp >> 8;
    tx->len=8;

    //修改保持寄存器
    for (i = 0; i < pmb->len; i++)
    {
        pmb->buf[pmb->start + i] = (uint16_t)(rx.buf[i * 2 + 7] << 8) + rx.buf[i * 2 + 8];
    }
    esp_log_buffer_hex("pmb->buf  ", pmb->buf, 10);

}
/*帧检测*/
uint8_t frm_cheak(_serialbuf_st *rx, _mbfrm_st *pfrm)
{
    uint16_t t, len;
    if (rx->len < 4)
        return res_ERR1;
    len = rx->len;
    rx->len = 0;

    pfrm->addr = rx->buf[0];
    if (pfrm->addr != local_addr)
        return res_ERR2;
    pfrm->crc = (uint16_t)(rx->buf[len - 1] << 8) + (rx->buf[len - 2]);
    t = usMBCRC16(rx->buf, len - 2);
    //ESP_LOGI("serial  ", "crc %d", t);
    if (pfrm->crc != t)
        return res_ERR3;
    pfrm->cmd = rx->buf[1];
    pfrm->start = (uint16_t)(rx->buf[2] << 8) + rx->buf[3];
    pfrm->rlen = (uint16_t)(rx->buf[4] << 8) + rx->buf[5];
    if (pfrm->start > 0x7d)
        return res_ERR4; //超出地址
    if (pfrm->rlen + pfrm->start > 0x7d)
        return res_ERR5; //超出长度
    return res_OK;
}

//接收
uint8_t smb_recvHoldingReg(_mbdata_st *pmb,_serialbuf_st serialRXbuf_st,_serialbuf_st *tx)
{
    uint8_t rel;
    _mbfrm_st frm;

    rel = frm_cheak(&serialRXbuf_st, &frm);
    ESP_LOGI("serial  ", "rel %d", rel);
    // ESP_LOGI("serial  ", "frm.addr %d", frm.addr);
    // ESP_LOGI("serial  ", "frm.crc %d", frm.crc);
    // ESP_LOGI("serial  ", "frm.rlen %d", frm.rlen);
    if (rel == res_OK)
    {
        gpio_set_level(MODRXorTX_GPIO, 0);
        //延时，给主机准备时间
        vTaskDelay(10 / portTICK_PERIOD_MS);
        pmb->len = frm.rlen;
        pmb->start = frm.start;
        switch (frm.cmd)
        {
        case 0x03: //读寄存器
            mb_sentfor_readHoldingReg(*pmb,tx);
            break;
        case 0x10: //写寄存器
            mb_sentfor_writeHoldingReg(serialRXbuf_st,pmb,tx);
            break;
        }
        gpio_set_level(MODRXorTX_GPIO, 1);
    }
    else if (rel == res_ERR3)
    {
        mb_sentACK(frm.cmd, rel,tx);
    }
    return rel;
}
